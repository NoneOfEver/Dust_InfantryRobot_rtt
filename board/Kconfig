## board/Kconfig
```kconfig
menu "Hardware Drivers Config"

menu "Onboard Peripheral Drivers"

endmenu

menu "On-chip Peripheral Drivers"

    config BSP_USING_GPIO
        bool "Enable GPIO"
        select RT_USING_PIN
        default y

menuconfig BSP_USING_UART
        bool "Enable UART"
        default y
        select RT_USING_SERIAL
        if BSP_USING_UART
            config BSP_STM32_UART_V1_TX_TIMEOUT
                int "UART TX timeout"
                default 6000
                depends on RT_USING_SERIAL_V1
                
            menuconfig BSP_USING_UART7
                bool "Enable UART7"
                default y
                if BSP_USING_UART7
                    config BSP_UART7_RX_USING_DMA
                        bool "Enable UART7 RX DMA"
                        depends on BSP_USING_UART7 && RT_SERIAL_USING_DMA
                        default n

                    config BSP_UART7_TX_USING_DMA
                        bool "Enable UART7 TX DMA"
                        depends on BSP_USING_UART7 && RT_SERIAL_USING_DMA
                        default n
                        
                    config BSP_UART7_RX_BUFSIZE
                        int "Set UART7 RX buffer size"
                        range 64 65535
                        depends on RT_USING_SERIAL_V2
                        default 256

                    config BSP_UART7_TX_BUFSIZE
                        int "Set UART7 TX buffer size"
                        range 0 65535
                        depends on RT_USING_SERIAL_V2
                        default 0

                    config BSP_UART7_DMA_PING_BUFSIZE
                        int "Set UART7 RX DMA ping-pong buffer size"
                        range 32 65535
                        depends on RT_USING_SERIAL_V2 && BSP_UART1_RX_USING_DMA
                        default 64    
                endif

        endif

    source "$(BSP_DIR)/libraries/HAL_Drivers/drivers/Kconfig"

endmenu

menu "Board extended module Drivers"

endmenu

endmenu
```
